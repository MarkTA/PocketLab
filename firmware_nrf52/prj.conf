## CMakeLists.txt
```
cmake_minimum_required(VERSION 3.20.0)

find_package(Zephyr REQUIRED HINTS $ENV{ZEPHYR_BASE})
project(pocketlab_evt1_bringup)

target_sources(app PRIVATE
    src/main.c
    src/power.c
    src/relay.c
    src/ads1220.c
    src/voltage.c
    src/resistance.c
    src/led.c
    src/ble.c
)
```

## prj.conf
```kconfig
CONFIG_GPIO=y

CONFIG_SERIAL=n
CONFIG_UART_CONSOLE=n

CONFIG_CONSOLE=y
CONFIG_PRINTK=y
CONFIG_USE_SEGGER_RTT=y
CONFIG_RTT_CONSOLE=y

CONFIG_CLOCK_CONTROL_NRF_K32SRC_RC=y
CONFIG_CLOCK_CONTROL_NRF_K32SRC_XTAL=n

CONFIG_BT=y
CONFIG_BT_PERIPHERAL=y
CONFIG_BT_DEVICE_NAME="PocketLab-EVT1"
CONFIG_BT_MAX_CONN=1

CONFIG_BT_L2CAP_TX_MTU=247
CONFIG_BT_BUF_ACL_RX_SIZE=251

CONFIG_CBPRINTF_FP_SUPPORT=y
```

## boards/nrf52840dk_nrf52840.overlay
```dts
&qspi {
    status = "disabled";
};

&gpio0 {
    gpio-reserved-ranges = <0 2>, <6 1>, <8 3>;
};
```

## src/main.c
```c
#include <zephyr/kernel.h>
#include <zephyr/sys/printk.h>

#include "power.h"
#include "led.h"
#include "ble.h"
#include "ads1220.h"
#include "resistance.h"
#include "board_pins.h"
#include <hal/nrf_gpio.h>

/* Power down after two minutes without a BLE connection. */
#define BLE_DISCONNECT_TIMEOUT_MS 120000LL

int main(void)
{
    power_init();
    /* EVT1: unused P1.05 remains LOW so the old MOSFET gate cannot turn on. */
    nrf_gpio_pin_clear(PIN_LED_R);
    nrf_gpio_cfg_output(PIN_LED_R);
    led_init();
    resistance_init();

    power_5v_enable();
    k_msleep(10);

    power_analog_enable();
    k_msleep(10);

    printk("PocketLab EVT1 startup\n");

    if (ble_init() != 0) {
        printk("BLE startup failed\n");
    }

    if (!ads1220_init()) {
        printk("ADS1220 init failed\n");
    }

    /*
     * The idle timer starts at boot, so a device that is never connected
     * also shuts down. While connected, the timer stays disarmed. An
     * unexpected disconnect starts a fresh two-minute grace period.
     *
     * Keep the final shutdown on the main thread: power_shutdown()
     * disables the rails, releases the power latch, and does not return.
     */
    int64_t disconnected_since_ms = k_uptime_get();
    printk("[POWER] No BLE connection; shutdown in 120 seconds\n");

    while (1) {
        if (ble_is_connected()) {
            disconnected_since_ms = -1;
        } else {
            if (disconnected_since_ms < 0) {
                disconnected_since_ms = k_uptime_get();
                printk("[POWER] BLE disconnected; shutdown in 120 seconds\n");
            }

            if (k_uptime_get() - disconnected_since_ms >= BLE_DISCONNECT_TIMEOUT_MS) {
                printk("[POWER] BLE idle timeout; shutting down\n");
                power_shutdown();
            }
        }

        k_sleep(K_SECONDS(1));
    }
}
```

## src/ads1220.c
```c
#include "ads1220.h"
#include "board_pins.h"

#include <hal/nrf_gpio.h>

#include <zephyr/kernel.h>
#include <zephyr/sys/printk.h>

#include <stddef.h>
#include <stdint.h>

/* -------------------------------------------------------------------------- */
/* ADS1220 commands                                                           */
/* -------------------------------------------------------------------------- */

#define ADS1220_CMD_RESET       0x06
#define ADS1220_CMD_START_SYNC  0x08
#define ADS1220_CMD_RDATA       0x10

/*
 * RREG command:
 *
 * 0010 rr nn
 *
 * Start at register 0 and read 4 registers:
 *
 * rr = 00
 * nn = 11  -> 4 registers
 *
 * = 0x23
 */
#define ADS1220_CMD_RREG_4      0x23

/*
 * WREG, starting register 0, write four registers.
 *
 * = 0x43
 */
#define ADS1220_CMD_WREG_4      0x43

/* -------------------------------------------------------------------------- */
/* Conversion constants                                                       */
/* -------------------------------------------------------------------------- */

#define ADS1220_VREF_VOLTS      2.048
#define ADS1220_FULL_SCALE      8388608.0   /* 2^23 */

/*
 * 20 SPS gives a conversion period of approximately 50 ms.
 * Allow plenty of margin for startup/debugging.
 */
#define ADS1220_DRDY_TIMEOUT_MS 250

/*
 * Bit-banged SPI clock timing.
 *
 * 1 us half-period ~= 500 kHz SPI.
 * Plenty fast for the ADS1220 and easy to debug.
 */
#define ADS1220_SPI_DELAY_US    1

/* -------------------------------------------------------------------------- */
/* GPIO / SPI helpers                                                         */
/* -------------------------------------------------------------------------- */

static void spi_delay(void)
{
    k_busy_wait(ADS1220_SPI_DELAY_US);
}

static void ads_select(void)
{
    nrf_gpio_pin_clear(PIN_ADC_CS);
    spi_delay();
}

static void ads_deselect(void)
{
    spi_delay();
    nrf_gpio_pin_set(PIN_ADC_CS);
}

/*
 * ADS1220 uses SPI mode 1:
 *
 * CPOL = 0
 * CPHA = 1
 *
 * Clock idles LOW.
 * Data is sampled on the falling edge.
 */
static uint8_t spi_transfer_byte(uint8_t tx)
{
    uint8_t rx = 0;

    for (int bit = 7; bit >= 0; bit--) {

        /*
         * Present MOSI before the active clock pulse.
         */
        if (tx & (1U << bit)) {
            nrf_gpio_pin_set(PIN_ADC_MOSI);
        } else {
            nrf_gpio_pin_clear(PIN_ADC_MOSI);
        }

        /*
         * Leading edge.
         */
        nrf_gpio_pin_set(PIN_ADC_SCLK);
        spi_delay();

        /*
         * Trailing edge: ADS1220 mode-1 data is valid here.
         */
        nrf_gpio_pin_clear(PIN_ADC_SCLK);

        if (nrf_gpio_pin_read(PIN_ADC_MISO)) {
            rx |= (1U << bit);
        }

        spi_delay();
    }

    return rx;
}

static void ads_command(uint8_t command)
{
    ads_select();

    spi_transfer_byte(command);

    ads_deselect();
}

/* -------------------------------------------------------------------------- */
/* Register access                                                            */
/* -------------------------------------------------------------------------- */

static void ads_write_registers(
    uint8_t reg0,
    uint8_t reg1,
    uint8_t reg2,
    uint8_t reg3)
{
    ads_select();

    spi_transfer_byte(ADS1220_CMD_WREG_4);

    spi_transfer_byte(reg0);
    spi_transfer_byte(reg1);
    spi_transfer_byte(reg2);
    spi_transfer_byte(reg3);

    ads_deselect();
}

static void ads_read_registers(uint8_t regs[4])
{
    ads_select();

    spi_transfer_byte(ADS1220_CMD_RREG_4);

    regs[0] = spi_transfer_byte(0x00);
    regs[1] = spi_transfer_byte(0x00);
    regs[2] = spi_transfer_byte(0x00);
    regs[3] = spi_transfer_byte(0x00);

    ads_deselect();
}

/* -------------------------------------------------------------------------- */
/* DRDY                                                                       */
/* -------------------------------------------------------------------------- */

static bool wait_for_drdy(void)
{
    int64_t start = k_uptime_get();

    while (nrf_gpio_pin_read(PIN_ADC_DRDY)) {

        if ((k_uptime_get() - start) >= ADS1220_DRDY_TIMEOUT_MS) {
            printk("ADS1220 DRDY timeout\n");
            return false;
        }

        k_msleep(1);
    }

    return true;
}

/* -------------------------------------------------------------------------- */
/* Initialization                                                             */
/* -------------------------------------------------------------------------- */

bool ads1220_init(void)
{
    /*
     * SPI outputs.
     */
    nrf_gpio_cfg_output(PIN_ADC_CS);
    nrf_gpio_cfg_output(PIN_ADC_SCLK);
    nrf_gpio_cfg_output(PIN_ADC_MOSI);

    /*
     * SPI / status inputs.
     */
    nrf_gpio_cfg_input(PIN_ADC_MISO, NRF_GPIO_PIN_NOPULL);
    nrf_gpio_cfg_input(PIN_ADC_DRDY, NRF_GPIO_PIN_NOPULL);

    /*
     * SPI mode 1 idle state:
     * CPOL = 0
     * CPHA = 1
     */
    nrf_gpio_pin_set(PIN_ADC_CS);
    nrf_gpio_pin_clear(PIN_ADC_SCLK);
    nrf_gpio_pin_clear(PIN_ADC_MOSI);

    /*
     * Allow the analog rails / ADC supply to settle.
     */
    k_msleep(1);

    /*
     * Reset the ADS1220.
     */
    ads_command(ADS1220_CMD_RESET);

    /*
     * Datasheet requires a short delay after RESET before register access.
     */
    k_msleep(1);

    /*
     * Default startup mode for PocketLab is voltage measurement.
     *
     * This configures:
     *   AIN0 - AIN2
     *   gain = 1
     *   PGA bypass
     *   internal 2.048 V reference
     *   20 SPS
     *   single-shot
     */
    if (!ads1220_config_voltage()) {
        printk("ADS1220 voltage configuration failed\n");
        return false;
    }

    printk("ADS1220 initialized\n");

    return true;
}

/* -------------------------------------------------------------------------- */
/* Conversion                                                                 */
/* -------------------------------------------------------------------------- */

bool ads1220_read_raw(int32_t *raw)
{
    if (raw == NULL) {
        return false;
    }

    /*
     * In single-shot mode, START/SYNC begins one conversion.
     */
    ads_command(ADS1220_CMD_START_SYNC);

    if (!wait_for_drdy()) {
        return false;
    }

    /*
     * Read the 24-bit conversion result.
     */
    ads_select();

    spi_transfer_byte(ADS1220_CMD_RDATA);

    uint8_t b0 = spi_transfer_byte(0x00);
    uint8_t b1 = spi_transfer_byte(0x00);
    uint8_t b2 = spi_transfer_byte(0x00);

    ads_deselect();

    int32_t code =
        ((int32_t)b0 << 16) |
        ((int32_t)b1 << 8)  |
        ((int32_t)b2);

    /*
     * Sign extend 24-bit two's-complement result to int32_t.
     */
    if (code & 0x00800000) {
        code |= (int32_t)0xFF000000;
    }

    *raw = code;

    return true;
}

/* -------------------------------------------------------------------------- */
/* Conversion helper                                                          */
/* -------------------------------------------------------------------------- */

double ads1220_raw_to_volts(int32_t raw)
{
    return ((double)raw / ADS1220_FULL_SCALE) *
           ADS1220_VREF_VOLTS;
}

/* -------------------------------------------------------------------------- */
/* Configure helpers                                                          */
/* -------------------------------------------------------------------------- */

static bool ads_configure(
    uint8_t reg0,
    uint8_t reg1,
    uint8_t reg2,
    uint8_t reg3)
{
    ads_write_registers(
        reg0,
        reg1,
        reg2,
        reg3
    );

    k_msleep(1);

    uint8_t regs[4] = {0};

    ads_read_registers(regs);

    printk(
        "ADS1220 regs: %02X %02X %02X %02X\n",
        regs[0],
        regs[1],
        regs[2],
        regs[3]
    );

    if (regs[0] != reg0 ||
        regs[1] != reg1 ||
        regs[2] != reg2 ||
        regs[3] != reg3) {

        printk("ADS1220 register verification FAILED\n");
        return false;
    }

    return true;
}

bool ads1220_config_voltage(void)
{
    /*
     * CONFIG0 = 0x11
     *
     * MUX = 0001 : AIN0 - AIN2
     * gain = 1
     * PGA bypass
     *
     * CONFIG2:
     * internal 2.048 V reference
     */
    return ads_configure(
        0x11,
        0x00,
        0x00,
        0x00
    );
}

bool ads1220_config_resistance(void)
{
    /*
     * CONFIG0 = 0x31
     *
     * MUX = 0011 : AIN1 - AIN2
     * gain = 1
     * PGA bypass
     *
     * CONFIG2 = 0x40
     *
     * VREF = external REF0
     */
    return ads_configure(
        0x31,
        0x00,
        0x40,
        0x00
    );
}

/* -------------------------------------------------------------------------- */
/* Fast continuity configuration                                               */
/* -------------------------------------------------------------------------- */

bool ads1220_config_continuity(void)
{
    /* Keep resistance-mode analog routing (AIN1-AIN2, external REF0).
     * CONFIG1 DR[2:0] = 101 and MODE[1:0] = 00:
     *   - 600 SPS nominal (normal mode)
     *   - Single-shot conversions (CM = 0)
     *   - ~1.7 ms nominal ADC conversion time per reading
     *
     * This trades noise performance for fast contact detection. Normal
     * voltage/resistance modes continue to use their original 20 SPS setup.
     * See TI ADS1220 datasheet: CONFIG1 bit layout and data-rate table.
     */
    return ads_configure(
        0x31,  /* AIN1 - AIN2, gain 1, PGA bypass */
        0xA0,  /* DR = 101 (600 SPS), normal mode, single shot */
        0x40,  /* External REF0 */
        0x00
    );
}
```

## src/ads1220.h
```c
#pragma once

#include <stdbool.h>
#include <stdint.h>

bool ads1220_init(void);

bool ads1220_config_voltage(void);
bool ads1220_config_resistance(void);
/* Fixed 10K resistance path, normal-mode 600 SPS single-shot.
 * Only select this configuration when the continuity worker owns the ADC. */
bool ads1220_config_continuity(void);

bool ads1220_read_raw(int32_t *raw);

double ads1220_raw_to_volts(int32_t raw);
```

## src/ble.c
```c
#include "ble.h"
#include "led.h"
#include "voltage.h"
#include "ads1220.h"
#include "resistance.h"
#include "power.h"
#include "board_pins.h"

#include <hal/nrf_gpio.h>

#include <zephyr/bluetooth/bluetooth.h>
#include <zephyr/bluetooth/conn.h>
#include <zephyr/bluetooth/gatt.h>
#include <zephyr/kernel.h>
#include <zephyr/sys/atomic.h>
#include <zephyr/sys/printk.h>

#include <errno.h>
#include <stdbool.h>
#include <stdint.h>
#include <string.h>
#include <stdio.h>


typedef enum {
    DMM_MODE_VOLTAGE,
    DMM_MODE_RESISTANCE,
    DMM_MODE_CONTINUITY,
} dmm_mode_t;

/* These flags cross BLE callback / continuity worker / system work contexts. */
static atomic_t current_dmm_mode = ATOMIC_INIT(DMM_MODE_VOLTAGE);
static atomic_t connected_state = ATOMIC_INIT(0);
static atomic_t continuity_active = ATOMIC_INIT(0);
static atomic_t continuity_detected = ATOMIC_INIT(0);

/* Serializes all ADS1220 accesses and DMM mode changes. */
K_MUTEX_DEFINE(dmm_mutex);
K_SEM_DEFINE(continuity_wake, 0, 1);

#define CONTINUITY_ON_OHMS 30.0
#define CONTINUITY_OFF_OHMS 40.0
#define CONTINUITY_POLL_GAP_MS 1 /* Additional pause AFTER each fast ADC conversion. */
#define CONTINUITY_ON_CONFIRM_SAMPLES   2
#define CONTINUITY_OFF_CONFIRM_SAMPLES  2

/* Cached status is only accessed while dmm_mutex is held. */
static resistance_result_t continuity_result = RESISTANCE_RESULT_ERROR;
static double continuity_ohms;
static bool continuity_has_sample;


/* EVT1 uses phone audio. No hardware PWM or buzzer output is configured.
 * P1.05 (former red LED / buzzer gate) is held LOW in main.c.
 * Notifications use the existing PocketLab response characteristic. */
static void continuity_set_detected(bool detected)
{
    if (!!atomic_get(&continuity_detected) == detected) {
        return;
    }
    atomic_set(&continuity_detected, detected ? 1 : 0);
    (void)ble_send_response(detected ? "CONTINUITY=ON" : "CONTINUITY=OFF");
}

/* Remove resistance excitation immediately on mode exit / disconnect. */
static void continuity_disable_immediately(void)
{
    atomic_clear(&continuity_active);
    nrf_gpio_pin_clear(PIN_MODE_RELAY_EN);
    nrf_gpio_pin_clear(PIN_MUX_EN);
    /* Callers reset/notify continuity state after acquiring dmm_mutex. */
}

/* Continuity worker owns the ADC and debounce state while in continuity mode.
 * State transitions are notified once, not on every resistance sample. */
static void continuity_thread(void *a, void *b, void *c)
{
    ARG_UNUSED(a);
    ARG_UNUSED(b);
    ARG_UNUSED(c);

    uint8_t on_confirm_count = 0;
    uint8_t off_confirm_count = 0;

    while (true) {
        k_sem_take(&continuity_wake, K_FOREVER);
        on_confirm_count = 0;
        off_confirm_count = 0;

        while (atomic_get(&continuity_active)) {
            k_mutex_lock(&dmm_mutex, K_FOREVER);
            if (atomic_get(&continuity_active) &&
                atomic_get(&connected_state) &&
                atomic_get(&current_dmm_mode) == DMM_MODE_CONTINUITY) {
                double ohms = 0.0;
                resistance_result_t result = resistance_read_continuity(&ohms);

                /* Disconnect or mode change can occur during ADC conversion. */
                if (atomic_get(&continuity_active) &&
                    atomic_get(&connected_state) &&
                    atomic_get(&current_dmm_mode) == DMM_MODE_CONTINUITY) {
                    continuity_result = result;
                    continuity_has_sample =
                        (result != RESISTANCE_RESULT_ERROR);

                    if (result == RESISTANCE_RESULT_OK) {
                        continuity_ohms = ohms;
                        if (!atomic_get(&continuity_detected)) {
                            off_confirm_count = 0;
                            if (ohms <= CONTINUITY_ON_OHMS) {
                                if (++on_confirm_count >= CONTINUITY_ON_CONFIRM_SAMPLES) {
                                    continuity_set_detected(true);
                                    on_confirm_count = 0;
                                }
                            } else {
                                on_confirm_count = 0;
                            }
                        } else {
                            on_confirm_count = 0;
                            if (ohms >= CONTINUITY_OFF_OHMS) {
                                if (++off_confirm_count >= CONTINUITY_OFF_CONFIRM_SAMPLES) {
                                    continuity_set_detected(false);
                                    off_confirm_count = 0;
                                }
                            } else {
                                off_confirm_count = 0;
                            }
                        }
                    } else {
                        /* Invalid/OL readings must mute phone audio promptly. */
                        on_confirm_count = 0;
                        off_confirm_count = 0;
                        continuity_set_detected(false);
                    }
                }
            }
            k_mutex_unlock(&dmm_mutex);
            k_msleep(CONTINUITY_POLL_GAP_MS);
        }
        on_confirm_count = 0;
        off_confirm_count = 0;
    }
}

/* Dedicated low-priority worker; no additional source/CMake changes needed. */
K_THREAD_DEFINE(continuity_thread_id, 3072, continuity_thread,
                NULL, NULL, NULL, 10, 0, 0);

/* The BLE disconnect callback must not run blocking SPI/ADC operations.
 * Relay and resistance excitation are disabled synchronously; ADC
 * reconfiguration is deferred to system workqueue context. */
static void disconnect_safe_mode_work_handler(struct k_work *work)
{
    ARG_UNUSED(work);
    k_mutex_lock(&dmm_mutex, K_FOREVER);
    /* Reconnect may have selected another mode while this work was queued. */
    if (atomic_get(&current_dmm_mode) == DMM_MODE_VOLTAGE) {
        resistance_exit_mode();
        if (!ads1220_config_voltage()) {
            printk("[DMM] ERROR: voltage ADC config failed after disconnect\n");
        } else {
            printk("[DMM] Returned to voltage mode after disconnect\n");
        }
    }
    k_mutex_unlock(&dmm_mutex);
}
K_WORK_DEFINE(disconnect_safe_mode_work, disconnect_safe_mode_work_handler);


/* -------------------------------------------------------------------------- */
/* PocketLab UUIDs                                                            */
/* -------------------------------------------------------------------------- */

/*
 * Service:
 * 8f5b0001-6c4d-4a73-a8f1-3d9ea01c0001
 *
 * Command RX:
 * 8f5b0002-6c4d-4a73-a8f1-3d9ea01c0001
 *
 * Response TX:
 * 8f5b0003-6c4d-4a73-a8f1-3d9ea01c0001
 */

#define BT_UUID_POCKETLAB_SERVICE_VAL \
    BT_UUID_128_ENCODE(0x8f5b0001, 0x6c4d, 0x4a73, 0xa8f1, 0x3d9ea01c0001)

#define BT_UUID_POCKETLAB_COMMAND_RX_VAL \
    BT_UUID_128_ENCODE(0x8f5b0002, 0x6c4d, 0x4a73, 0xa8f1, 0x3d9ea01c0001)

#define BT_UUID_POCKETLAB_RESPONSE_TX_VAL \
    BT_UUID_128_ENCODE(0x8f5b0003, 0x6c4d, 0x4a73, 0xa8f1, 0x3d9ea01c0001)

static struct bt_uuid_128 pocketlab_service_uuid =
    BT_UUID_INIT_128(BT_UUID_POCKETLAB_SERVICE_VAL);

static struct bt_uuid_128 pocketlab_command_rx_uuid =
    BT_UUID_INIT_128(BT_UUID_POCKETLAB_COMMAND_RX_VAL);

static struct bt_uuid_128 pocketlab_response_tx_uuid =
    BT_UUID_INIT_128(BT_UUID_POCKETLAB_RESPONSE_TX_VAL);

/* -------------------------------------------------------------------------- */
/* State                                                                      */
/* -------------------------------------------------------------------------- */

static bool restart_advertising = false;

#define COMMAND_BUFFER_SIZE 64

static char last_command[COMMAND_BUFFER_SIZE];

/* Forward declaration because the write callback uses the service. */
static ssize_t command_write_cb(
    struct bt_conn *conn,
    const struct bt_gatt_attr *attr,
    const void *buf,
    uint16_t len,
    uint16_t offset,
    uint8_t flags);

static ssize_t command_read_cb(
    struct bt_conn *conn,
    const struct bt_gatt_attr *attr,
    void *buf,
    uint16_t len,
    uint16_t offset);

static void response_ccc_changed(
    const struct bt_gatt_attr *attr,
    uint16_t value);

/* -------------------------------------------------------------------------- */
/* PocketLab GATT service                                                     */
/* -------------------------------------------------------------------------- */

BT_GATT_SERVICE_DEFINE(
    pocketlab_service,

    BT_GATT_PRIMARY_SERVICE(&pocketlab_service_uuid),

    /*
     * Command RX
     *
     * READ is included because the existing app has diagnostic read-back
     * support in addition to normal command writes.
     */
    BT_GATT_CHARACTERISTIC(
        &pocketlab_command_rx_uuid.uuid,
        BT_GATT_CHRC_READ |
            BT_GATT_CHRC_WRITE |
            BT_GATT_CHRC_WRITE_WITHOUT_RESP,
        BT_GATT_PERM_READ | BT_GATT_PERM_WRITE,
        command_read_cb,
        command_write_cb,
        last_command),

    /*
     * Response TX
     */
    BT_GATT_CHARACTERISTIC(
        &pocketlab_response_tx_uuid.uuid,
        BT_GATT_CHRC_NOTIFY,
        BT_GATT_PERM_NONE,
        NULL,
        NULL,
        NULL),

    BT_GATT_CCC(
        response_ccc_changed,
        BT_GATT_PERM_READ | BT_GATT_PERM_WRITE));

/* -------------------------------------------------------------------------- */
/* Response handling                                                          */
/* -------------------------------------------------------------------------- */

int ble_send_response(const char *response)
{
    if (response == NULL) {
        return -EINVAL;
    }

    if (!atomic_get(&connected_state)) {
        return -ENOTCONN;
    }

    /*
     * Attribute 4 is the value attribute for RESPONSE_TX:
     *
     * 0 = primary service
     * 1 = COMMAND_RX characteristic declaration
     * 2 = COMMAND_RX value
     * 3 = RESPONSE_TX characteristic declaration
     * 4 = RESPONSE_TX value
     * 5 = CCC
     */
    int err = bt_gatt_notify(
        NULL,
        &pocketlab_service.attrs[4],
        response,
        strlen(response));

    if (err) {
        printk("BLE notify failed: %d\n", err);
        return err;
    }

    printk("BLE TX: %s\n", response);

    return 0;
}

/* -------------------------------------------------------------------------- */
/* Command handling                                                           */
/* -------------------------------------------------------------------------- */

static void handle_command(const char *command)
{
    printk("BLE RX: %s\n", command);

    if (strcmp(command, "PING") == 0) {
        ble_send_response("PONG");
        return;
    }

    if (strcmp(command, "INFO") == 0) {
        ble_send_response(
            "INFO MODEL=PocketLab-Base;"
            "FW=0.3.0-EVT1;"
            "HW=EVT1-NRF52840");
        return;
    }

    if (strcmp(command, "FEATURES") == 0) {
        ble_send_response("FEATURES DMM");
        return;
    }

    /*
     * Report current DMM state.
     *
     * In resistance mode, report the actual autorange-selected
     * reference resistor.
     */
    if (strcmp(command, "DMM:GET_STATE") == 0) {
        char response[96];
        k_mutex_lock(&dmm_mutex, K_FOREVER);
        dmm_mode_t mode = (dmm_mode_t)atomic_get(&current_dmm_mode);
        if (mode == DMM_MODE_CONTINUITY) {
            snprintf(response, sizeof(response),
                     "DMM:STATE MODE=CONTINUITY;RANGE=10K;RREF=10000");
        } else if (mode == DMM_MODE_RESISTANCE) {
            snprintf(response, sizeof(response),
                     "DMM:STATE MODE=RESISTANCE;RANGE=%s;RREF=%.0f",
                     resistance_get_range_name(), resistance_get_rref_ohms());
        } else {
            snprintf(response, sizeof(response), "DMM:STATE MODE=VOLTAGE;RANGE=FIXED");
        }
        k_mutex_unlock(&dmm_mutex);
        ble_send_response(response);
        return;
    }

    /* All mode transitions disable resistance excitation before reconfiguring ADC. */
    if (strcmp(command, "DMM:SET_MODE VOLTAGE") == 0 ||
        strcmp(command, "DMM:SET_MODE RESISTANCE") == 0 ||
        strcmp(command, "DMM:SET_MODE CONTINUITY") == 0) {

        continuity_disable_immediately();
        k_mutex_lock(&dmm_mutex, K_FOREVER);
        continuity_has_sample = false;
        continuity_result = RESISTANCE_RESULT_ERROR;
        continuity_set_detected(false);

        bool ok = false;
        char response[96];
        if (strcmp(command, "DMM:SET_MODE VOLTAGE") == 0) {
            resistance_exit_mode();
            atomic_set(&current_dmm_mode, DMM_MODE_VOLTAGE);
            ok = ads1220_config_voltage();
            if (ok) {
                k_msleep(25);
                snprintf(response, sizeof(response), "DMM:STATE MODE=VOLTAGE;RANGE=FIXED");
            }
        } else if (strcmp(command, "DMM:SET_MODE RESISTANCE") == 0) {
            ok = resistance_enter_mode();
            if (ok) {
                atomic_set(&current_dmm_mode, DMM_MODE_RESISTANCE);
                snprintf(response, sizeof(response),
                         "DMM:STATE MODE=RESISTANCE;RANGE=%s;RREF=%.0f",
                         resistance_get_range_name(), resistance_get_rref_ohms());
            }
        } else {
            /* Keep the existing 10K reference and relay setup, but use a
             * much faster ADC rate only in continuity mode. */
            ok = resistance_enter_mode();
            if (ok) {
                ok = ads1220_config_continuity();
            }
            if (ok) {
                atomic_set(&current_dmm_mode, DMM_MODE_CONTINUITY);
                snprintf(response, sizeof(response),
                         "DMM:STATE MODE=CONTINUITY;RANGE=10K;RREF=10000");
                atomic_set(&continuity_active, 1);
            }
        }

        if (!ok) {
            resistance_exit_mode();
            atomic_set(&current_dmm_mode, DMM_MODE_VOLTAGE);
            (void)ads1220_config_voltage();
        }
        k_mutex_unlock(&dmm_mutex);

        ble_send_response(ok ? response : "ERR ADC_CONFIG_FAILED");
        if (ok && atomic_get(&continuity_active)) {
            /* Explicit initial state for the app's audio component. */
            (void)ble_send_response("CONTINUITY=OFF");
            k_sem_give(&continuity_wake);
        }
        return;
    }

    if (strcmp(command, "DMM:READ") == 0) {
        char response[128];
        bool ok = false;
        k_mutex_lock(&dmm_mutex, K_FOREVER);
        dmm_mode_t mode = (dmm_mode_t)atomic_get(&current_dmm_mode);

        if (mode == DMM_MODE_VOLTAGE) {
            double volts;
            if (voltage_read(&volts)) {
                snprintf(response, sizeof(response), "DMM:VALUE %.6f;UNIT=V", volts);
                ok = true;
            }
        } else if (mode == DMM_MODE_RESISTANCE) {
            double ohms;
            resistance_result_t result = resistance_read(&ohms);
            if (result == RESISTANCE_RESULT_OPEN) {
                snprintf(response, sizeof(response),
                         "DMM:VALUE OL;UNIT=OHM;RANGE=%s;RREF=%.0f",
                         resistance_get_range_name(), resistance_get_rref_ohms());
                ok = true;
            } else if (result == RESISTANCE_RESULT_OK) {
                snprintf(response, sizeof(response),
                         "DMM:VALUE %.3f;UNIT=OHM;RANGE=%s;RREF=%.0f",
                         ohms, resistance_get_range_name(), resistance_get_rref_ohms());
                ok = true;
            }
        } else if (mode == DMM_MODE_CONTINUITY && continuity_has_sample) {
            const int detected = atomic_get(&continuity_detected) ? 1 : 0;
            if (continuity_result == RESISTANCE_RESULT_OPEN) {
                snprintf(response, sizeof(response),
                         "DMM:VALUE OL;UNIT=OHM;MODE=CONTINUITY;CONT=0;RANGE=10K;RREF=10000");
                ok = true;
            } else if (continuity_result == RESISTANCE_RESULT_OK) {
                snprintf(response, sizeof(response),
                         "DMM:VALUE %.3f;UNIT=OHM;MODE=CONTINUITY;CONT=%d;RANGE=10K;RREF=10000",
                         continuity_ohms, detected);
                ok = true;
            }
        }
        k_mutex_unlock(&dmm_mutex);
        ble_send_response(ok ? response : "ERR DMM_READ_FAILED");
        return;
    }

    /*
     * Controlled software power-down.
     */
    if (strcmp(command, "POWER:SHUTDOWN") == 0) {
        continuity_disable_immediately();
        ble_send_response("OK SHUTTING_DOWN");

        /*
         * Give BLE a moment to transmit the acknowledgement
         * before removing power.
         */
        k_msleep(100);

        power_shutdown();

        return;
    }

    ble_send_response("ERR UNKNOWN_COMMAND");
}

/* -------------------------------------------------------------------------- */
/* GATT callbacks                                                             */
/* -------------------------------------------------------------------------- */

static ssize_t command_write_cb(
    struct bt_conn *conn,
    const struct bt_gatt_attr *attr,
    const void *buf,
    uint16_t len,
    uint16_t offset,
    uint8_t flags)
{
    ARG_UNUSED(conn);
    ARG_UNUSED(attr);
    ARG_UNUSED(flags);

    /*
     * Keep the first protocol implementation simple:
     * commands must arrive as a complete write starting at offset 0.
     */
    if (offset != 0) {
        return BT_GATT_ERR(BT_ATT_ERR_INVALID_OFFSET);
    }

    if (len == 0 || len >= COMMAND_BUFFER_SIZE) {
        return BT_GATT_ERR(BT_ATT_ERR_INVALID_ATTRIBUTE_LEN);
    }

    memcpy(last_command, buf, len);
    last_command[len] = '\0';

    /*
     * Strip CR/LF in case commands are ever sent from a terminal-like client.
     */
    while (len > 0 &&
           (last_command[len - 1] == '\r' ||
            last_command[len - 1] == '\n')) {
        last_command[len - 1] = '\0';
        len--;
    }

    handle_command(last_command);

    return len;
}

static ssize_t command_read_cb(
    struct bt_conn *conn,
    const struct bt_gatt_attr *attr,
    void *buf,
    uint16_t len,
    uint16_t offset)
{
    const char *value = attr->user_data;

    return bt_gatt_attr_read(
        conn,
        attr,
        buf,
        len,
        offset,
        value,
        strlen(value));
}

static void response_ccc_changed(
    const struct bt_gatt_attr *attr,
    uint16_t value)
{
    ARG_UNUSED(attr);

    if (value == BT_GATT_CCC_NOTIFY) {
        printk("PocketLab notifications enabled\n");
    } else {
        printk("PocketLab notifications disabled\n");
    }
}

/* -------------------------------------------------------------------------- */
/* Advertising                                                                */
/* -------------------------------------------------------------------------- */

static const struct bt_data ad[] = {
    BT_DATA_BYTES(
        BT_DATA_FLAGS,
        BT_LE_AD_GENERAL | BT_LE_AD_NO_BREDR),

    /*
     * Advertise the PocketLab service UUID.
     * The app currently scans all BLE devices, but this lets us filter by
     * service UUID later.
     */
    BT_DATA_BYTES(
        BT_DATA_UUID128_ALL,
        BT_UUID_POCKETLAB_SERVICE_VAL),
};

static const struct bt_data sd[] = {
    BT_DATA(
        BT_DATA_NAME_COMPLETE,
        CONFIG_BT_DEVICE_NAME,
        sizeof(CONFIG_BT_DEVICE_NAME) - 1),
};

static int start_advertising(void)
{
    int err = bt_le_adv_start(
        BT_LE_ADV_CONN_FAST_2,
        ad,
        ARRAY_SIZE(ad),
        sd,
        ARRAY_SIZE(sd));

    if (err) {
        printk("Advertising failed: %d\n", err);
        led_off();
        return err;
    }

    printk("Advertising as %s\n", CONFIG_BT_DEVICE_NAME);

    led_set_advertising();

    return 0;
}

/* -------------------------------------------------------------------------- */
/* Connection handling                                                        */
/* -------------------------------------------------------------------------- */

static void advertising_restart_work_handler(struct k_work *work)
{
    ARG_UNUSED(work);

    printk("Restarting advertising...\n");

    int err = start_advertising();

    if (err) {
        printk("Advertising restart failed: %d\n", err);
    }
}

K_WORK_DEFINE(
    advertising_restart_work,
    advertising_restart_work_handler);

static void connected(
    struct bt_conn *conn,
    uint8_t err)
{
    ARG_UNUSED(conn);

    if (err) {
        printk("BLE connection failed: %u\n", err);
        return;
    }

    atomic_set(&connected_state, 1);
    restart_advertising = false;

    printk("BLE connected\n");

    led_set_connected();
}

static void disconnected(
    struct bt_conn *conn,
    uint8_t reason)
{
    ARG_UNUSED(conn);

    atomic_clear(&connected_state);
    restart_advertising = true;

    /* Immediately remove resistance excitation and reset continuity state. */
    continuity_disable_immediately();
    atomic_clear(&continuity_detected);
    atomic_set(&current_dmm_mode, DMM_MODE_VOLTAGE);

    printk("BLE disconnected: %u\n", reason);
    led_off();
    k_work_submit(&disconnect_safe_mode_work);
}

static void recycled(void)
{
    if (!restart_advertising) {
        return;
    }

    restart_advertising = false;

    printk("Connection recycled\n");

    k_work_submit(&advertising_restart_work);
}

BT_CONN_CB_DEFINE(connection_callbacks) = {
    .connected = connected,
    .disconnected = disconnected,
    .recycled = recycled,
};

/* -------------------------------------------------------------------------- */
/* Public API                                                                 */
/* -------------------------------------------------------------------------- */

int ble_init(void)
{
    int err;

    atomic_clear(&connected_state);
    restart_advertising = false;
    last_command[0] = '\0';

    /* Safe power-on relay state independent of RGB LED state. */
    continuity_disable_immediately();
    led_off();

    err = bt_enable(NULL);

    if (err) {
        printk("Bluetooth init failed: %d\n", err);
        return err;
    }

    printk("Bluetooth initialized\n");

    return start_advertising();
}

bool ble_is_connected(void)
{
    return atomic_get(&connected_state) != 0;
}
```

## src/ble.h
```c
#pragma once

#include <stdbool.h>

int ble_init(void);
bool ble_is_connected(void);

/* Send a UTF-8 response through the PocketLab TX characteristic. */
int ble_send_response(const char *response);
```

## src/board_pins.h
```c
#pragma once

#include <hal/nrf_gpio.h>

/* Power */
#define PIN_POWER_HOLD      NRF_GPIO_PIN_MAP(0, 23)
#define PIN_5V_EN           NRF_GPIO_PIN_MAP(1, 3)
#define PIN_ANALOG_PWR_EN   NRF_GPIO_PIN_MAP(1, 7)
#define PIN_ANALOG_PGOOD_N  NRF_GPIO_PIN_MAP(1, 4)

/* Relay */
#define PIN_MODE_RELAY_EN   NRF_GPIO_PIN_MAP(0, 19)

/* ADS1220 */
#define PIN_ADC_CS          NRF_GPIO_PIN_MAP(1, 12)
#define PIN_ADC_SCLK        NRF_GPIO_PIN_MAP(0, 27)
#define PIN_ADC_MOSI        NRF_GPIO_PIN_MAP(0, 8)
#define PIN_ADC_MISO        NRF_GPIO_PIN_MAP(0, 6)
#define PIN_ADC_DRDY        NRF_GPIO_PIN_MAP(1, 14)

/* Resistance mux */
#define PIN_MUX_A0          NRF_GPIO_PIN_MAP(1, 11)
#define PIN_MUX_EN          NRF_GPIO_PIN_MAP(1, 13)
#define PIN_MUX_A1          NRF_GPIO_PIN_MAP(1, 15)

/* I2C / module */
#define PIN_I2C_SCL         NRF_GPIO_PIN_MAP(0, 22)
#define PIN_I2C_SDA         NRF_GPIO_PIN_MAP(0, 24)
#define PIN_MODULE_INT_N    NRF_GPIO_PIN_MAP(0, 26)

/* RGB LED */
#define PIN_LED_R  NRF_GPIO_PIN_MAP(1, 5)
#define PIN_LED_B  NRF_GPIO_PIN_MAP(1, 6)
#define PIN_LED_G  NRF_GPIO_PIN_MAP(1, 1)

/* Charger status */
#define PIN_BQ_CHG          NRF_GPIO_PIN_MAP(0, 25)
#define PIN_BQ_PGOOD        NRF_GPIO_PIN_MAP(1, 2)
```

## src/led.c
```c
#include "led.h"
#include "board_pins.h"

#include <hal/nrf_gpio.h>

static void led_all_off(void)
{
    
    nrf_gpio_pin_set(PIN_LED_G);
    nrf_gpio_pin_set(PIN_LED_B);
}

void led_init(void)
{
    
    nrf_gpio_cfg_output(PIN_LED_G);
    nrf_gpio_cfg_output(PIN_LED_B);

    led_all_off();
}

void led_off(void)
{
    led_all_off();
}

void led_set_green(void)
{
    led_all_off();
    nrf_gpio_pin_clear(PIN_LED_G);
}

void led_set_blue(void)
{
    led_all_off();
    nrf_gpio_pin_clear(PIN_LED_B);
}

void led_set_advertising(void)
{
    led_set_blue();
}

void led_set_connected(void)
{
    led_set_green();
}

void led_set_disconnected(void)
{
    led_all_off();
}
```

## src/led.h
```c
#pragma once

void led_init(void);

void led_off(void);
void led_set_green(void);
void led_set_blue(void);

void led_set_advertising(void);
void led_set_connected(void);
void led_set_disconnected(void);
```

## src/power.c
```c
#include "power.h"
#include "board_pins.h"

#include <zephyr/kernel.h>
#include <hal/nrf_gpio.h>

void power_init(void)
{
    /* Outputs */
    nrf_gpio_cfg_output(PIN_POWER_HOLD);
    nrf_gpio_cfg_output(PIN_5V_EN);
    nrf_gpio_cfg_output(PIN_ANALOG_PWR_EN);

    /*
     * BQ24074 status outputs are open-drain and active-low.
     * The PCB already provides pull-ups to 3V3, but enabling the
     * MCU pull-ups as well gives us a defined state during bring-up.
     */
    nrf_gpio_cfg_input(PIN_BQ_PGOOD, NRF_GPIO_PIN_PULLUP);
    nrf_gpio_cfg_input(PIN_BQ_CHG, NRF_GPIO_PIN_PULLUP);

    /*
     * Immediately latch main power on.
     */
    power_hold_enable();

    /*
     * Leave downstream supplies off until explicitly enabled.
     */
    power_5v_disable();
    power_analog_disable();
}

void power_hold_enable(void)
{
    nrf_gpio_pin_set(PIN_POWER_HOLD);
}

void power_hold_disable(void)
{
    nrf_gpio_pin_clear(PIN_POWER_HOLD);
}

void power_5v_enable(void)
{
    nrf_gpio_pin_set(PIN_5V_EN);
}

void power_5v_disable(void)
{
    nrf_gpio_pin_clear(PIN_5V_EN);
}

void power_analog_enable(void)
{
    nrf_gpio_pin_set(PIN_ANALOG_PWR_EN);
}

void power_analog_disable(void)
{
    nrf_gpio_pin_clear(PIN_ANALOG_PWR_EN);
}

bool power_usb_present(void)
{
    /*
     * BQ24074 PGOOD is active-low:
     * LOW  = valid USB/input power present
     * HIGH = no valid input power
     */
    return nrf_gpio_pin_read(PIN_BQ_PGOOD) == 0;
}

bool power_is_charging(void)
{
    /*
     * BQ24074 CHG is active-low:
     * LOW  = charging
     * HIGH = not charging
     */
    return nrf_gpio_pin_read(PIN_BQ_CHG) == 0;
}

void power_shutdown(void)
{
    /*
     * Shut down downstream supplies first.
     */
    power_analog_disable();
    power_5v_disable();

    /*
     * Give the rails a moment to settle before removing main power.
     */
    k_msleep(20);

    /*
     * Release the power latch.
     * Once this goes LOW, MAIN_PWR_EN should fall and the MCU
     * will lose power.
     */
    power_hold_disable();

    /*
     * We should never meaningfully return from here because
     * the MCU is about to lose power.
     */
    while (1) {
        k_sleep(K_FOREVER);
    }
}
```

## src/power.h
```c
#pragma once

#include <stdbool.h>

void power_init(void);

void power_hold_enable(void);
void power_hold_disable(void);

void power_5v_enable(void);
void power_5v_disable(void);

void power_analog_enable(void);
void power_analog_disable(void);

bool power_usb_present(void);
bool power_is_charging(void);

void power_shutdown(void);
```

## src/r_range.c
```c
#include <zephyr/kernel.h>
#include <zephyr/sys/printk.h>
#include <hal/nrf_gpio.h>
#include <stdint.h>

/* ---------- Power ---------- */

#define POWER_HOLD_PIN      NRF_GPIO_PIN_MAP(0, 23)
#define FIVE_V_EN_PIN       NRF_GPIO_PIN_MAP(1, 3)
#define ANALOG_PWR_EN_PIN   NRF_GPIO_PIN_MAP(1, 7)

/* ---------- Relay ---------- */

#define MODE_RELAY_EN_PIN   NRF_GPIO_PIN_MAP(0, 19)

/* ---------- TMUX ---------- */

#define MUX_A0_PIN          NRF_GPIO_PIN_MAP(1, 11)
#define MUX_EN_PIN          NRF_GPIO_PIN_MAP(1, 13)
#define MUX_A1_PIN          NRF_GPIO_PIN_MAP(1, 15)

/* ---------- ADS1220 ---------- */

#define ADS_CS_PIN          NRF_GPIO_PIN_MAP(1, 12)
#define ADS_SCLK_PIN        NRF_GPIO_PIN_MAP(0, 27)
#define ADS_MOSI_PIN        NRF_GPIO_PIN_MAP(0, 8)
#define ADS_MISO_PIN        NRF_GPIO_PIN_MAP(0, 6)
#define ADS_DRDY_PIN        NRF_GPIO_PIN_MAP(1, 14)

#define ADS_RESET           0x06
#define ADS_START_SYNC      0x08
#define ADS_RDATA           0x10
#define ADS_RREG            0x20
#define ADS_WREG            0x40

#define ADC_FS              8388608.0f

struct resistance_range {
    uint8_t a1;
    uint8_t a0;
    float rref;
    const char *name;
};

static const struct resistance_range ranges[] = {
    {0, 0,   10000.0f, "10 kOhm"},
    {0, 1,  100000.0f, "100 kOhm"},
    {1, 0,  360000.0f, "360 kOhm"},
    {1, 1, 1000000.0f, "1 MOhm"},
};

static void spi_delay(void)
{
    k_busy_wait(2);
}

/* ADS1220 SPI mode 1 */
static uint8_t ads_spi_transfer(uint8_t tx)
{
    uint8_t rx = 0;

    for (int bit = 7; bit >= 0; bit--) {

        if (tx & (1U << bit))
            nrf_gpio_pin_set(ADS_MOSI_PIN);
        else
            nrf_gpio_pin_clear(ADS_MOSI_PIN);

        nrf_gpio_pin_set(ADS_SCLK_PIN);
        spi_delay();

        nrf_gpio_pin_clear(ADS_SCLK_PIN);

        rx <<= 1;

        if (nrf_gpio_pin_read(ADS_MISO_PIN))
            rx |= 1;

        spi_delay();
    }

    return rx;
}

static void ads_command(uint8_t command)
{
    nrf_gpio_pin_clear(ADS_CS_PIN);
    spi_delay();

    ads_spi_transfer(command);

    spi_delay();
    nrf_gpio_pin_set(ADS_CS_PIN);
}

static void ads_write_reg(uint8_t reg, uint8_t value)
{
    nrf_gpio_pin_clear(ADS_CS_PIN);
    spi_delay();

    ads_spi_transfer(ADS_WREG | (reg << 2));
    ads_spi_transfer(value);

    spi_delay();
    nrf_gpio_pin_set(ADS_CS_PIN);
}

static int32_t ads_read_conversion(void)
{
    uint32_t raw;

    nrf_gpio_pin_clear(ADS_CS_PIN);
    spi_delay();

    ads_spi_transfer(ADS_RDATA);

    uint8_t b2 = ads_spi_transfer(0x00);
    uint8_t b1 = ads_spi_transfer(0x00);
    uint8_t b0 = ads_spi_transfer(0x00);

    nrf_gpio_pin_set(ADS_CS_PIN);

    raw = ((uint32_t)b2 << 16) |
          ((uint32_t)b1 << 8) |
          b0;

    if (raw & 0x800000)
        raw |= 0xFF000000;

    return (int32_t)raw;
}

static void select_range(const struct resistance_range *range)
{
    /* Disconnect all RREFs first */
    nrf_gpio_pin_clear(MUX_EN_PIN);

    k_sleep(K_MSEC(5));

    if (range->a1)
        nrf_gpio_pin_set(MUX_A1_PIN);
    else
        nrf_gpio_pin_clear(MUX_A1_PIN);

    if (range->a0)
        nrf_gpio_pin_set(MUX_A0_PIN);
    else
        nrf_gpio_pin_clear(MUX_A0_PIN);

    k_sleep(K_MSEC(5));

    /* Connect selected RREF */
    nrf_gpio_pin_set(MUX_EN_PIN);

    /* Allow relay / mux / RC network to settle */
    k_sleep(K_MSEC(50));
}

static int32_t get_sample(void)
{
    ads_command(ADS_START_SYNC);

    int timeout = 200;

    while (nrf_gpio_pin_read(ADS_DRDY_PIN) && timeout > 0) {
        k_sleep(K_MSEC(1));
        timeout--;
    }

    if (timeout == 0)
        return INT32_MIN;

    return ads_read_conversion();
}

int main(void)
{
    /* ---------- Power ---------- */

    nrf_gpio_cfg_output(POWER_HOLD_PIN);
    nrf_gpio_pin_set(POWER_HOLD_PIN);

    nrf_gpio_cfg_output(FIVE_V_EN_PIN);
    nrf_gpio_pin_set(FIVE_V_EN_PIN);

    nrf_gpio_cfg_output(ANALOG_PWR_EN_PIN);
    nrf_gpio_pin_set(ANALOG_PWR_EN_PIN);

    k_sleep(K_MSEC(100));

    /* ---------- Relay ---------- */

    nrf_gpio_cfg_output(MODE_RELAY_EN_PIN);
    nrf_gpio_pin_set(MODE_RELAY_EN_PIN);   /* Resistance mode */

    /* ---------- TMUX ---------- */

    nrf_gpio_cfg_output(MUX_A0_PIN);
    nrf_gpio_cfg_output(MUX_A1_PIN);
    nrf_gpio_cfg_output(MUX_EN_PIN);

    nrf_gpio_pin_clear(MUX_EN_PIN);

    /* ---------- ADS1220 ---------- */

    nrf_gpio_cfg_output(ADS_CS_PIN);
    nrf_gpio_cfg_output(ADS_SCLK_PIN);
    nrf_gpio_cfg_output(ADS_MOSI_PIN);

    nrf_gpio_cfg_input(ADS_MISO_PIN, NRF_GPIO_PIN_NOPULL);
    nrf_gpio_cfg_input(ADS_DRDY_PIN, NRF_GPIO_PIN_NOPULL);

    nrf_gpio_pin_set(ADS_CS_PIN);
    nrf_gpio_pin_clear(ADS_SCLK_PIN);
    nrf_gpio_pin_clear(ADS_MOSI_PIN);

    k_sleep(K_MSEC(100));

    ads_command(ADS_RESET);
    k_sleep(K_MSEC(2));

    /*
     * AIN1 - AIN2
     * Gain = 1
     * PGA bypass
     */
    ads_write_reg(0, 0x31);

    /* 20 SPS, single-shot */
    ads_write_reg(1, 0x00);

    /* External REF0, 50/60-Hz rejection */
    ads_write_reg(2, 0x50);

    /* IDACs off */
    ads_write_reg(3, 0x00);

    printk("\nPocketLab resistance range test\n");
    printk("================================\n");

    while (1) {

        for (int r = 0; r < 4; r++) {

            const struct resistance_range *range = &ranges[r];

            select_range(range);

            printk("\n");
            printk(">>> RREF = %s   A1:A0 = %d%d <<<\n",
                   range->name,
                   range->a1,
                   range->a0);

            /*
             * Discard first conversion after switching ranges.
             */
            get_sample();

            /*
             * About 9 readings at 1-second intervals.
             */
            for (int i = 0; i < 9; i++) {

                int32_t raw = get_sample();

                if (raw == INT32_MIN) {
                    printk("DRDY TIMEOUT\n");
                    k_sleep(K_SECONDS(1));
                    continue;
                }

                /*
                 * Treat extremely near-full-scale as open.
                 */
                if (raw >= 8346665) {  /* ~99.5% FS */
                    printk("RAW: %ld   R: OL\n", (long)raw);
                }
                else if (raw > 0) {

                    float resistance =
                        range->rref *
                        ((float)raw /
                        (ADC_FS - (float)raw));

                    if (resistance >= 1000000.0f) {

                        int whole = (int)(resistance / 1000000.0f);
                        int frac =
                            (int)((resistance / 1000.0f)) % 1000;

                        printk("RAW: %ld   R: %d.%03d MOhm\n",
                               (long)raw,
                               whole,
                               frac);
                    }
                    else if (resistance >= 1000.0f) {

                        int whole = (int)(resistance / 1000.0f);
                        int frac =
                            ((int)resistance) % 1000;

                        printk("RAW: %ld   R: %d.%03d kOhm\n",
                               (long)raw,
                               whole,
                               frac);
                    }
                    else {

                        printk("RAW: %ld   R: %d Ohm\n",
                               (long)raw,
                               (int)resistance);
                    }
                }
                else {
                    printk("RAW: %ld   R: invalid\n", (long)raw);
                }

                k_sleep(K_SECONDS(1));
            }
        }
    }
}
```

## src/resistance.h
```c
#pragma once

#include <stdbool.h>

/* -------------------------------------------------------------------------- */
/* Resistance ranges                                                          */
/* -------------------------------------------------------------------------- */

typedef enum {
    RESISTANCE_RANGE_10K = 0,
    RESISTANCE_RANGE_100K,
    RESISTANCE_RANGE_360K,
    RESISTANCE_RANGE_1M,
} resistance_range_t;

/* -------------------------------------------------------------------------- */
/* Resistance measurement results                                             */
/* -------------------------------------------------------------------------- */

typedef enum {
    RESISTANCE_RESULT_OK = 0,
    RESISTANCE_RESULT_OPEN,
    RESISTANCE_RESULT_ERROR,
} resistance_result_t;

/* -------------------------------------------------------------------------- */
/* Public API                                                                 */
/* -------------------------------------------------------------------------- */

void resistance_init(void);

bool resistance_enter_mode(void);

void resistance_exit_mode(void);

resistance_result_t resistance_read(double *ohms);

/* Single fixed-10K ADC conversion for fast, autonomous continuity detection.
 * Caller must hold the DMM/ADC mutex (owned by ble.c). */
resistance_result_t resistance_read_continuity(double *ohms);

resistance_range_t resistance_get_range(void);

double resistance_get_rref_ohms(void);

const char *resistance_get_range_name(void);
```
